/ {
  // Motivation for having different overlays: we plan to use differents boards.
  arduino-digital {
    compatible = "gpio-leds";  // still using gpio-leds binding for now
    D8: digital-d8 {
      gpios = <&gpio2 02 GPIO_ACTIVE_HIGH>;
		  label = "Arduino D8";
    };
  };
  aliases {
    dio8 = &D8;
  };
};
